/dts-v1/;

/ {
	model = "Nothing Phone (1) (Spacewar) - Caly 6.12 LTS";
	compatible = "qcom,yupik-idp", "qcom,yupik", "qcom,qrd";
	qcom,msm-id = <0x1db 0x10000 0x203 0x10000>;
	qcom,board-id = <0x1000b 0x00>;

	fragment@38 {
		target = <0xffffffff>;

		__overlay__ {

			qcom,mdss_dsi_rm692e5_visionox_amoled_120hz_cmd {
				qcom,mdss-dsi-panel-name = "rm692e5 amoled fhd+ 120hz cmd mode dsi visionox panel";
				qcom,mdss-dsi-panel-type = "dsi_cmd_mode";
				qcom,mdss-dsi-panel-physical-type = "oled";
				qcom,dsi-ctrl-num = <0x00>;
				qcom,dsi-phy-num = <0x00>;
				qcom,mdss-dsi-virtual-channel-id = <0x00>;
				qcom,mdss-dsi-stream = <0x00>;
				qcom,mdss-dsi-bpp = <0x18>;
				qcom,mdss-dsi-color-order = "rgb_swap_rgb";
				qcom,mdss-dsi-underflow-color = <0xff>;
				qcom,mdss-dsi-border-color = <0x00>;
				qcom,mdss-dsi-h-sync-pulse = <0x00>;
				qcom,mdss-dsi-traffic-mode = "non_burst_sync_event";
				qcom,mdss-dsi-lane-map = "lane_map_0123";
				qcom,mdss-dsi-bllp-eof-power-mode;
				qcom,mdss-dsi-bllp-power-mode;
				qcom,mdss-dsi-tx-eot-append;
				qcom,mdss-dsi-lane-0-state;
				qcom,mdss-dsi-lane-1-state;
				qcom,mdss-dsi-lane-2-state;
				qcom,mdss-dsi-lane-3-state;
				qcom,mdss-dsi-dma-trigger = "trigger_sw";
				qcom,mdss-dsi-mdp-trigger = "none";
				qcom,mdss-dsi-lp11-init;
				qcom,mdss-dsi-reset-sequence = <0x01 0x0a 0x00 0x01 0x01 0x20>;
				qcom,mdss-pan-physical-width-dimension = <0x44>;
				qcom,mdss-pan-physical-height-dimension = <0x98>;
				qcom,mdss-dsi-te-pin-select = <0x01>;
				qcom,mdss-dsi-wr-mem-start = <0x2c>;
				qcom,mdss-dsi-wr-mem-continue = <0x3c>;
				qcom,mdss-dsi-te-dcs-command = <0x01>;
				qcom,mdss-dsi-te-check-enable;
				qcom,mdss-dsi-te-using-te-pin;
				qcom,dsi-select-clocks = "pll_byte_clk0", "pll_dsi_clk0";
				qcom,dynamic-mode-switch-enabled;
				qcom,dynamic-mode-switch-type = "dynamic-resolution-switch-immediate";
				qcom,dsi-dyn-clk-enable;
				qcom,dsi-dyn-clk-list = <0x35772240>;
				qcom,esd-check-enabled;
				qcom,mdss-dsi-panel-status-check-mode = "reg_read";
				qcom,mdss-dsi-panel-status-command = <0x6010001 0x10a>;
				qcom,mdss-dsi-panel-status-command-state = "dsi_lp_mode";
				qcom,mdss-dsi-panel-status-value = <0x9c>;
				qcom,mdss-dsi-panel-status-read-length = <0x01>;
				qcom,panel-supply-entries = <0x3c>;
				qcom,mdss-dsi-bl-pmic-control-type = "bl_ctrl_dcs";
				qcom,mdss-dsi-bl-min-level = <0x01>;
				qcom,mdss-dsi-bl-max-level = <0xfff>;
				qcom,mdss-dsi-bl-hbm-level = <0xffe>;
				qcom,mdss-brightness-max-level = <0xfff>;
				qcom,mdss-dsi-bl-inverted-dbv;
				qcom,platform-reset-gpio = <0xffffffff 0x2c 0x00>;
				phandle = <0x3e>;

				qcom,mdss-dsi-display-timings {

					timing@0 {
						qcom,mdss-dsi-panel-width = <0x438>;
						qcom,mdss-dsi-panel-height = <0x960>;
						qcom,mdss-dsi-h-front-porch = <0x1a>;
						qcom,mdss-dsi-h-back-porch = <0x24>;
						qcom,mdss-dsi-h-pulse-width = <0x27>;
						qcom,mdss-dsi-h-sync-skew = <0x00>;
						qcom,mdss-dsi-v-back-porch = <0x10>;
						qcom,mdss-dsi-v-front-porch = <0x10>;
						qcom,mdss-dsi-v-pulse-width = <0x15>;
						qcom,mdss-dsi-panel-framerate = <0x3c>;
						qcom,mdss-dsi-timing-switch-command = [15 01 00 00 00 00 02 fe 40 15 01 00 00 00 00 02 bd 00 15 01 00 00 22 00 02 fe 00];
						qcom,mdss-dsi-on-command = [15 01 00 00 00 00 02 fe 40 15 01 00 00 22 00 02 bd 00 15 01 00 00 00 00 02 fe d2 15 01 00 00 00 00 02 50 11 15 01 00 00 00 00 02 51 ab 15 01 00 00 00 00 02 52 30 15 01 00 00 00 00 02 53 09 15 01 00 00 00 00 02 54 60 15 01 00 00 00 00 02 55 04 15 01 00 00 00 00 02 56 38 15 01 00 00 00 00 02 58 00 15 01 00 00 00 00 02 59 14 15 01 00 00 00 00 02 5a 02 15 01 00 00 00 00 02 5b 1c 15 01 00 00 00 00 02 5c 02 15 01 00 00 00 00 02 5d 00 15 01 00 00 00 00 02 5e 20 15 01 00 00 00 00 02 5f 01 15 01 00 00 00 00 02 60 e8 15 01 00 00 00 00 02 61 00 15 01 00 00 00 00 02 62 07 15 01 00 00 00 00 02 63 0c 15 01 00 00 00 00 02 64 05 15 01 00 00 00 00 02 65 0e 15 01 00 00 00 00 02 66 05 15 01 00 00 00 00 02 67 16 15 01 00 00 00 00 02 68 18 15 01 00 00 00 00 02 69 00 15 01 00 00 00 00 02 6a 10 15 01 00 00 00 00 02 6b f0 15 01 00 00 00 00 02 6c 07 15 01 00 00 00 00 02 6d 10 15 01 00 00 00 00 02 6e 20 15 01 00 00 00 00 02 6f 00 15 01 00 00 00 00 02 70 06 15 01 00 00 00 00 02 71 0f 15 01 00 00 00 00 02 72 0f 15 01 00 00 00 00 02 73 33 15 01 00 00 00 00 02 74 0e 15 01 00 00 00 00 02 75 1c 15 01 00 00 00 00 02 76 2a 15 01 00 00 00 00 02 77 38 15 01 00 00 00 00 02 78 46 15 01 00 00 00 00 02 79 54 15 01 00 00 00 00 02 7a 62 15 01 00 00 00 00 02 7b 69 15 01 00 00 00 00 02 7c 70 15 01 00 00 00 00 02 7d 77 15 01 00 00 00 00 02 7e 79 15 01 00 00 00 00 02 7f 7b 15 01 00 00 00 00 02 80 7d 15 01 00 00 00 00 02 81 7e 15 01 00 00 00 00 02 82 01 15 01 00 00 00 00 02 83 02 15 01 00 00 00 00 02 84 22 15 01 00 00 00 00 02 85 00 15 01 00 00 00 00 02 86 2a 15 01 00 00 00 00 02 87 40 15 01 00 00 00 00 02 88 2a 15 01 00 00 00 00 02 89 be 15 01 00 00 00 00 02 8a 3a 15 01 00 00 00 00 02 8b fc 15 01 00 00 00 00 02 8c 3a 15 01 00 00 00 00 02 8d fa 15 01 00 00 00 00 02 8e 3a 15 01 00 00 00 00 02 8f f8 15 01 00 00 00 00 02 90 3b 15 01 00 00 00 00 02 91 38 15 01 00 00 00 00 02 92 3b 15 01 00 00 00 00 02 93 78 15 01 00 00 00 00 02 94 3b 15 01 00 00 00 00 02 95 b6 15 01 00 00 00 00 02 96 4b 15 01 00 00 00 00 02 97 f6 15 01 00 00 00 00 02 98 4c 15 01 00 00 00 00 02 99 34 15 01 00 00 00 00 02 9a 4c 15 01 00 00 00 00 02 9b 74 15 01 00 00 00 00 02 9c 5c 15 01 00 00 00 00 02 9d 74 15 01 00 00 00 00 02 9e 8c 15 01 00 00 00 00 02 9f f4 15 01 00 00 00 00 02 a2 02 15 01 00 00 00 00 02 a3 1c 15 01 00 00 00 00 02 a4 00 15 01 00 00 00 00 02 a5 00 15 01 00 00 00 00 02 a6 00 15 01 00 00 00 00 02 a7 00 15 01 00 00 00 00 02 a9 00 15 01 00 00 00 00 02 aa 00 15 01 00 00 00 00 02 a0 80 15 01 00 00 00 00 02 fe a1 15 01 00 00 00 00 02 cd 6b 15 01 00 00 00 00 02 ce bb 15 01 00 00 00 00 02 fe d1 15 01 00 00 00 00 02 b4 01 15 01 00 00 00 00 02 fe 38 15 01 00 00 00 00 02 17 0f 15 01 00 00 00 00 02 18 0f 15 01 00 00 00 00 02 fe 00 15 01 00 00 00 00 02 fa 01 15 01 00 00 00 00 02 c2 08 15 01 00 00 00 00 02 35 00 15 01 00 00 00 00 03 51 0d bb 05 01 00 00 32 00 02 11 00 05 01 00 00 01 00 02 29 00];
						qcom,mdss-dsi-off-command = [05 01 00 00 01 00 02 28 00 05 01 00 00 01 00 02 10 00];
						qcom,mdss-dsi-on-command-state = "dsi_lp_mode";
						qcom,mdss-dsi-off-command-state = "dsi_hs_mode";
						qcom,mdss-dsi-lp1-command = [15 01 00 00 00 00 02 fe 00 05 01 00 00 00 00 01 39];
						qcom,mdss-dsi-lp1-command-state = "dsi_lp_mode";
						qcom,mdss-dsi-nolp-command = [15 01 00 00 00 00 02 fe 00 05 01 00 00 00 00 01 38];
						qcom,mdss-dsi-nolp-command-state = "dsi_lp_mode";
						qcom,mdss-dsi-h-sync-pulse = <0x00>;
						qcom,compression-mode = "dsc";
						qcom,mdss-dsc-slice-height = <0x14>;
						qcom,mdss-dsc-slice-width = <0x21c>;
						qcom,mdss-dsc-slice-per-pkt = <0x02>;
						qcom,mdss-dsc-bit-per-component = <0x0a>;
						qcom,mdss-dsc-bit-per-pixel = <0x08>;
						qcom,mdss-dsc-block-prediction-enable;
						qcom,mdss-dsi-panel-phy-timings = [00 1c 07 07 17 16 07 07 08 02 04 00 18 0c];
						qcom,display-topology = <0x01 0x01 0x01>;
						qcom,default-topology-index = <0x00>;
						qcom,dsi-dyn-clk-list = <0x35772240>;
					};

					timing@1 {
						qcom,mdss-dsi-panel-width = <0x438>;
						qcom,mdss-dsi-panel-height = <0x960>;
						qcom,mdss-dsi-h-front-porch = <0x1a>;
						qcom,mdss-dsi-h-back-porch = <0x24>;
						qcom,mdss-dsi-h-pulse-width = <0x27>;
						qcom,mdss-dsi-h-sync-skew = <0x00>;
						qcom,mdss-dsi-v-back-porch = <0x10>;
						qcom,mdss-dsi-v-front-porch = <0x10>;
						qcom,mdss-dsi-v-pulse-width = <0x15>;
						qcom,mdss-dsi-panel-framerate = <0x5a>;
						qcom,mdss-dsi-timing-switch-command = [15 01 00 00 00 00 02 fe 40 15 01 00 00 00 00 02 bd 06 15 01 00 00 17 00 02 fe 00];
						qcom,mdss-dsi-on-command = [15 01 00 00 00 00 02 fe 40 15 01 00 00 17 00 02 bd 06 15 01 00 00 00 00 02 fe d2 15 01 00 00 00 00 02 50 11 15 01 00 00 00 00 02 51 ab 15 01 00 00 00 00 02 52 30 15 01 00 00 00 00 02 53 09 15 01 00 00 00 00 02 54 60 15 01 00 00 00 00 02 55 04 15 01 00 00 00 00 02 56 38 15 01 00 00 00 00 02 58 00 15 01 00 00 00 00 02 59 14 15 01 00 00 00 00 02 5a 02 15 01 00 00 00 00 02 5b 1c 15 01 00 00 00 00 02 5c 02 15 01 00 00 00 00 02 5d 00 15 01 00 00 00 00 02 5e 20 15 01 00 00 00 00 02 5f 01 15 01 00 00 00 00 02 60 e8 15 01 00 00 00 00 02 61 00 15 01 00 00 00 00 02 62 07 15 01 00 00 00 00 02 63 0c 15 01 00 00 00 00 02 64 05 15 01 00 00 00 00 02 65 0e 15 01 00 00 00 00 02 66 05 15 01 00 00 00 00 02 67 16 15 01 00 00 00 00 02 68 18 15 01 00 00 00 00 02 69 00 15 01 00 00 00 00 02 6a 10 15 01 00 00 00 00 02 6b f0 15 01 00 00 00 00 02 6c 07 15 01 00 00 00 00 02 6d 10 15 01 00 00 00 00 02 6e 20 15 01 00 00 00 00 02 6f 00 15 01 00 00 00 00 02 70 06 15 01 00 00 00 00 02 71 0f 15 01 00 00 00 00 02 72 0f 15 01 00 00 00 00 02 73 33 15 01 00 00 00 00 02 74 0e 15 01 00 00 00 00 02 75 1c 15 01 00 00 00 00 02 76 2a 15 01 00 00 00 00 02 77 38 15 01 00 00 00 00 02 78 46 15 01 00 00 00 00 02 79 54 15 01 00 00 00 00 02 7a 62 15 01 00 00 00 00 02 7b 69 15 01 00 00 00 00 02 7c 70 15 01 00 00 00 00 02 7d 77 15 01 00 00 00 00 02 7e 79 15 01 00 00 00 00 02 7f 7b 15 01 00 00 00 00 02 80 7d 15 01 00 00 00 00 02 81 7e 15 01 00 00 00 00 02 82 01 15 01 00 00 00 00 02 83 02 15 01 00 00 00 00 02 84 22 15 01 00 00 00 00 02 85 00 15 01 00 00 00 00 02 86 2a 15 01 00 00 00 00 02 87 40 15 01 00 00 00 00 02 88 2a 15 01 00 00 00 00 02 89 be 15 01 00 00 00 00 02 8a 3a 15 01 00 00 00 00 02 8b fc 15 01 00 00 00 00 02 8c 3a 15 01 00 00 00 00 02 8d fa 15 01 00 00 00 00 02 8e 3a 15 01 00 00 00 00 02 8f f8 15 01 00 00 00 00 02 90 3b 15 01 00 00 00 00 02 91 38 15 01 00 00 00 00 02 92 3b 15 01 00 00 00 00 02 93 78 15 01 00 00 00 00 02 94 3b 15 01 00 00 00 00 02 95 b6 15 01 00 00 00 00 02 96 4b 15 01 00 00 00 00 02 97 f6 15 01 00 00 00 00 02 98 4c 15 01 00 00 00 00 02 99 34 15 01 00 00 00 00 02 9a 4c 15 01 00 00 00 00 02 9b 74 15 01 00 00 00 00 02 9c 5c 15 01 00 00 00 00 02 9d 74 15 01 00 00 00 00 02 9e 8c 15 01 00 00 00 00 02 9f f4 15 01 00 00 00 00 02 a2 02 15 01 00 00 00 00 02 a3 1c 15 01 00 00 00 00 02 a4 00 15 01 00 00 00 00 02 a5 00 15 01 00 00 00 00 02 a6 00 15 01 00 00 00 00 02 a7 00 15 01 00 00 00 00 02 a9 00 15 01 00 00 00 00 02 aa 00 15 01 00 00 00 00 02 a0 80 15 01 00 00 00 00 02 fe a1 15 01 00 00 00 00 02 cd 6b 15 01 00 00 00 00 02 ce bb 15 01 00 00 00 00 02 fe d1 15 01 00 00 00 00 02 b4 01 15 01 00 00 00 00 02 fe 38 15 01 00 00 00 00 02 17 0f 15 01 00 00 00 00 02 18 0f 15 01 00 00 00 00 02 fe 00 15 01 00 00 00 00 02 fa 01 15 01 00 00 00 00 02 c2 08 15 01 00 00 00 00 02 35 00 15 01 00 00 00 00 03 51 0d bb 05 01 00 00 32 00 02 11 00 05 01 00 00 01 00 02 29 00];
						qcom,mdss-dsi-off-command = [05 01 00 00 01 00 02 28 00 05 01 00 00 01 00 02 10 00];
						qcom,mdss-dsi-on-command-state = "dsi_lp_mode";
						qcom,mdss-dsi-off-command-state = "dsi_hs_mode";
						qcom,mdss-dsi-lp1-command = [15 01 00 00 00 00 02 fe 00 05 01 00 00 00 00 01 39];
						qcom,mdss-dsi-lp1-command-state = "dsi_lp_mode";
						qcom,mdss-dsi-nolp-command = [15 01 00 00 00 00 02 fe 00 05 01 00 00 00 00 01 38];
						qcom,mdss-dsi-nolp-command-state = "dsi_lp_mode";
						qcom,mdss-dsi-h-sync-pulse = <0x00>;
						qcom,compression-mode = "dsc";
						qcom,mdss-dsc-slice-height = <0x14>;
						qcom,mdss-dsc-slice-width = <0x21c>;
						qcom,mdss-dsc-slice-per-pkt = <0x02>;
						qcom,mdss-dsc-bit-per-component = <0x0a>;
						qcom,mdss-dsc-bit-per-pixel = <0x08>;
						qcom,mdss-dsc-block-prediction-enable;
						qcom,mdss-dsi-panel-phy-timings = [00 1c 07 07 17 16 07 07 08 02 04 00 18 0c];
						qcom,display-topology = <0x01 0x01 0x01>;
						qcom,default-topology-index = <0x00>;
						qcom,dsi-dyn-clk-list = <0x35772240>;
					};

					timing@2 {
						qcom,mdss-dsi-panel-width = <0x438>;
						qcom,mdss-dsi-panel-height = <0x960>;
						qcom,mdss-dsi-h-front-porch = <0x1a>;
						qcom,mdss-dsi-h-back-porch = <0x24>;
						qcom,mdss-dsi-h-pulse-width = <0x27>;
						qcom,mdss-dsi-h-sync-skew = <0x00>;
						qcom,mdss-dsi-v-back-porch = <0x10>;
						qcom,mdss-dsi-v-front-porch = <0x10>;
						qcom,mdss-dsi-v-pulse-width = <0x15>;
						qcom,mdss-dsi-panel-framerate = <0x78>;
						qcom,mdss-dsi-timing-switch-command = [15 01 00 00 00 00 02 fe 40 15 01 00 00 00 00 02 bd 07 15 01 00 00 11 00 02 fe 00];
						qcom,mdss-dsi-on-command = [15 01 00 00 00 00 02 fe 40 15 01 00 00 11 00 02 bd 07 15 01 00 00 00 00 02 fe d2 15 01 00 00 00 00 02 50 11 15 01 00 00 00 00 02 51 ab 15 01 00 00 00 00 02 52 30 15 01 00 00 00 00 02 53 09 15 01 00 00 00 00 02 54 60 15 01 00 00 00 00 02 55 04 15 01 00 00 00 00 02 56 38 15 01 00 00 00 00 02 58 00 15 01 00 00 00 00 02 59 14 15 01 00 00 00 00 02 5a 02 15 01 00 00 00 00 02 5b 1c 15 01 00 00 00 00 02 5c 02 15 01 00 00 00 00 02 5d 00 15 01 00 00 00 00 02 5e 20 15 01 00 00 00 00 02 5f 01 15 01 00 00 00 00 02 60 e8 15 01 00 00 00 00 02 61 00 15 01 00 00 00 00 02 62 07 15 01 00 00 00 00 02 63 0c 15 01 00 00 00 00 02 64 05 15 01 00 00 00 00 02 65 0e 15 01 00 00 00 00 02 66 05 15 01 00 00 00 00 02 67 16 15 01 00 00 00 00 02 68 18 15 01 00 00 00 00 02 69 00 15 01 00 00 00 00 02 6a 10 15 01 00 00 00 00 02 6b f0 15 01 00 00 00 00 02 6c 07 15 01 00 00 00 00 02 6d 10 15 01 00 00 00 00 02 6e 20 15 01 00 00 00 00 02 6f 00 15 01 00 00 00 00 02 70 06 15 01 00 00 00 00 02 71 0f 15 01 00 00 00 00 02 72 0f 15 01 00 00 00 00 02 73 33 15 01 00 00 00 00 02 74 0e 15 01 00 00 00 00 02 75 1c 15 01 00 00 00 00 02 76 2a 15 01 00 00 00 00 02 77 38 15 01 00 00 00 00 02 78 46 15 01 00 00 00 00 02 79 54 15 01 00 00 00 00 02 7a 62 15 01 00 00 00 00 02 7b 69 15 01 00 00 00 00 02 7c 70 15 01 00 00 00 00 02 7d 77 15 01 00 00 00 00 02 7e 79 15 01 00 00 00 00 02 7f 7b 15 01 00 00 00 00 02 80 7d 15 01 00 00 00 00 02 81 7e 15 01 00 00 00 00 02 82 01 15 01 00 00 00 00 02 83 02 15 01 00 00 00 00 02 84 22 15 01 00 00 00 00 02 85 00 15 01 00 00 00 00 02 86 2a 15 01 00 00 00 00 02 87 40 15 01 00 00 00 00 02 88 2a 15 01 00 00 00 00 02 89 be 15 01 00 00 00 00 02 8a 3a 15 01 00 00 00 00 02 8b fc 15 01 00 00 00 00 02 8c 3a 15 01 00 00 00 00 02 8d fa 15 01 00 00 00 00 02 8e 3a 15 01 00 00 00 00 02 8f f8 15 01 00 00 00 00 02 90 3b 15 01 00 00 00 00 02 91 38 15 01 00 00 00 00 02 92 3b 15 01 00 00 00 00 02 93 78 15 01 00 00 00 00 02 94 3b 15 01 00 00 00 00 02 95 b6 15 01 00 00 00 00 02 96 4b 15 01 00 00 00 00 02 97 f6 15 01 00 00 00 00 02 98 4c 15 01 00 00 00 00 02 99 34 15 01 00 00 00 00 02 9a 4c 15 01 00 00 00 00 02 9b 74 15 01 00 00 00 00 02 9c 5c 15 01 00 00 00 00 02 9d 74 15 01 00 00 00 00 02 9e 8c 15 01 00 00 00 00 02 9f f4 15 01 00 00 00 00 02 a2 02 15 01 00 00 00 00 02 a3 1c 15 01 00 00 00 00 02 a4 00 15 01 00 00 00 00 02 a5 00 15 01 00 00 00 00 02 a6 00 15 01 00 00 00 00 02 a7 00 15 01 00 00 00 00 02 a9 00 15 01 00 00 00 00 02 aa 00 15 01 00 00 00 00 02 a0 80 15 01 00 00 00 00 02 fe a1 15 01 00 00 00 00 02 cd 6b 15 01 00 00 00 00 02 ce bb 15 01 00 00 00 00 02 fe d1 15 01 00 00 00 00 02 b4 01 15 01 00 00 00 00 02 fe 38 15 01 00 00 00 00 02 17 0f 15 01 00 00 00 00 02 18 0f 15 01 00 00 00 00 02 fe 00 15 01 00 00 00 00 02 fa 01 15 01 00 00 00 00 02 c2 08 15 01 00 00 00 00 02 35 00 15 01 00 00 00 00 03 51 0d bb 05 01 00 00 32 00 02 11 00 05 01 00 00 01 00 02 29 00];
						qcom,mdss-dsi-off-command = [05 01 00 00 01 00 02 28 00 05 01 00 00 01 00 02 10 00];
						qcom,mdss-dsi-on-command-state = "dsi_lp_mode";
						qcom,mdss-dsi-off-command-state = "dsi_hs_mode";
						qcom,mdss-dsi-lp1-command = [15 01 00 00 00 00 02 fe 00 05 01 00 00 00 00 01 39];
						qcom,mdss-dsi-lp1-command-state = "dsi_lp_mode";
						qcom,mdss-dsi-nolp-command = [15 01 00 00 00 00 02 fe 00 05 01 00 00 00 00 01 38];
						qcom,mdss-dsi-nolp-command-state = "dsi_lp_mode";
						qcom,mdss-dsi-h-sync-pulse = <0x00>;
						qcom,compression-mode = "dsc";
						qcom,mdss-dsc-slice-height = <0x14>;
						qcom,mdss-dsc-slice-width = <0x21c>;
						qcom,mdss-dsc-slice-per-pkt = <0x02>;
						qcom,mdss-dsc-bit-per-component = <0x0a>;
						qcom,mdss-dsc-bit-per-pixel = <0x08>;
						qcom,mdss-dsc-block-prediction-enable;
						qcom,mdss-dsi-panel-phy-timings = [00 1c 07 07 17 16 07 07 08 02 04 00 18 0c];
						qcom,display-topology = <0x01 0x01 0x01>;
						qcom,default-topology-index = <0x00>;
						qcom,dsi-dyn-clk-list = <0x35772240>;
					};
				};
			};
		};
	};

	fragment@43 {
		target = <0xffffffff>;

		__overlay__ {

			dsi_panel_pwr_supply {
				#address-cells = <0x01>;
				#size-cells = <0x00>;

				qcom,panel-supply-entry@0 {
					reg = <0x00>;
					qcom,supply-name = "vddio";
					qcom,supply-min-voltage = <0x1b7740>;
					qcom,supply-max-voltage = <0x1b7740>;
					qcom,supply-enable-load = <0xed1c>;
					qcom,supply-disable-load = <0x50>;
					qcom,supply-post-on-sleep = <0x14>;
				};

				qcom,panel-supply-entry@1 {
					reg = <0x01>;
					qcom,supply-name = "vdd";
					qcom,supply-min-voltage = <0x2dc6c0>;
					qcom,supply-max-voltage = <0x2dc6c0>;
					qcom,supply-enable-load = <0x7530>;
					qcom,supply-disable-load = <0x00>;
					qcom,supply-post-on-sleep = <0x00>;
				};

				qcom,panel-supply-entry@2 {
					reg = <0x02>;
					qcom,supply-name = "lab";
					qcom,supply-min-voltage = <0x4630c0>;
					qcom,supply-max-voltage = <0x5b8d80>;
					qcom,supply-enable-load = <0x00>;
					qcom,supply-disable-load = <0x00>;
				};

				qcom,panel-supply-entry@3 {
					reg = <0x03>;
					qcom,supply-name = "ibb";
					qcom,supply-min-voltage = <0x4630c0>;
					qcom,supply-max-voltage = <0x5b8d80>;
					qcom,supply-enable-load = <0x00>;
					qcom,supply-disable-load = <0x00>;
					qcom,supply-post-on-sleep = <0x14>;
				};

				qcom,panel-supply-entry@4 {
					reg = <0x04>;
					qcom,supply-name = "extvdd";
					qcom,supply-min-voltage = <0x124f80>;
					qcom,supply-max-voltage = <0x124f80>;
					qcom,supply-enable-load = <0xed1c>;
					qcom,supply-disable-load = <0x50>;
					qcom,supply-post-on-sleep = <0x00>;
				};
			};

			dsi_panel_pwr_supply_labibb {
				#address-cells = <0x01>;
				#size-cells = <0x00>;

				qcom,panel-supply-entry@0 {
					reg = <0x00>;
					qcom,supply-name = "vddio";
					qcom,supply-min-voltage = <0x1b7740>;
					qcom,supply-max-voltage = <0x1b7740>;
					qcom,supply-enable-load = <0xf230>;
					qcom,supply-disable-load = <0x50>;
					qcom,supply-post-on-sleep = <0x14>;
				};

				qcom,panel-supply-entry@1 {
					reg = <0x01>;
					qcom,supply-name = "lab";
					qcom,supply-min-voltage = "", "Us";
					qcom,supply-max-voltage = <0x5b8d80>;
					qcom,supply-enable-load = <0x00>;
					qcom,supply-disable-load = <0x00>;
				};

				qcom,panel-supply-entry@2 {
					reg = <0x02>;
					qcom,supply-name = "ibb";
					qcom,supply-min-voltage = "", "Us";
					qcom,supply-max-voltage = <0x5b8d80>;
					qcom,supply-enable-load = <0x00>;
					qcom,supply-disable-load = <0x00>;
					qcom,supply-post-on-sleep = <0x14>;
				};
			};

			dsi_panel_pwr_supply_amoled {
				#address-cells = <0x01>;
				#size-cells = <0x00>;

				qcom,panel-supply-entry@0 {
					reg = <0x00>;
					qcom,supply-name = "vddio";
					qcom,supply-min-voltage = <0x1b7740>;
					qcom,supply-max-voltage = <0x1b7740>;
					qcom,supply-enable-load = <0xed1c>;
					qcom,supply-disable-load = <0x50>;
					qcom,supply-post-on-sleep = <0x14>;
				};

				qcom,panel-supply-entry@1 {
					reg = <0x01>;
					qcom,supply-name = "vdd";
					qcom,supply-min-voltage = <0x2dc6c0>;
					qcom,supply-max-voltage = <0x2dc6c0>;
					qcom,supply-enable-load = <0x7530>;
					qcom,supply-disable-load = <0x00>;
					qcom,supply-post-on-sleep = <0x00>;
				};
			};

			dsi_panel_pwr_supply_rm692e5 {
				#address-cells = <0x01>;
				#size-cells = <0x00>;
				phandle = <0x3c>;

				qcom,panel-supply-entry@0 {
					reg = <0x00>;
					qcom,supply-name = "vddio";
					qcom,supply-min-voltage = <0x1b7740>;
					qcom,supply-max-voltage = <0x1b7740>;
					qcom,supply-enable-load = <0xed1c>;
					qcom,supply-disable-load = <0x50>;
					qcom,supply-ulp-load = <0x7530>;
					qcom,supply-post-on-sleep = <0x02>;
				};

				qcom,panel-supply-entry@1 {
					reg = <0x01>;
					qcom,supply-name = "vdd";
					qcom,supply-min-voltage = <0x2dc6c0>;
					qcom,supply-max-voltage = <0x2dc6c0>;
					qcom,supply-enable-load = <0x7530>;
					qcom,supply-disable-load = <0x00>;
					qcom,supply-post-on-sleep = <0x00>;
					qcom,supply-post-off-sleep = <0x02>;
				};
			};

			dsi_panel_pwr_supply_no_labibb {
				#address-cells = <0x01>;
				#size-cells = <0x00>;
				phandle = <0x3d>;

				qcom,panel-supply-entry@0 {
					reg = <0x00>;
					qcom,supply-name = "vddio";
					qcom,supply-min-voltage = <0x1b7740>;
					qcom,supply-max-voltage = <0x1b7740>;
					qcom,supply-enable-load = <0xf230>;
					qcom,supply-disable-load = <0x50>;
					qcom,supply-post-on-sleep = <0x14>;
				};
			};

			qcom,dsi-display-primary {
				compatible = "qcom,dsi-display";
				label = "primary";
				qcom,dsi-ctrl = <0xffffffff>;
				qcom,dsi-phy = <0xffffffff>;
				qcom,mdp = <0xffffffff>;
				qcom,dsi-default-panel = <0x3e>;
				clocks = <0xffffffff 0x00 0xffffffff 0x01 0xffffffff 0x00 0xffffffff 0x01 0xffffffff 0x00 0xffffffff 0x01 0xffffffff 0x02 0xffffffff 0x03 0xffffffff 0x02 0xffffffff 0x03 0xffffffff 0x1b>;
				clock-names = "pll_byte_clk0", "pll_dsi_clk0", "cphy_byte_clk0", "cphy_pixel_clk0", "src_byte_clk0", "src_pixel_clk0", "shadow_byte_clk0", "shadow_pixel_clk0", "shadow_cphybyte_clk0", "shadow_cphypixel_clk0", "mdp_core_clk";
				qcom,platform-te-gpio = <0xffffffff 0x50 0x00>;
				qcom,panel-te-source = <0x00>;
				vddio-supply = <0xffffffff>;
				vdd-supply = <0xffffffff>;
			};
		};
	};

	fragment@64 {
		target = <0xffffffff>;

		__overlay__ {
			status = "disabled";
		};
	};

	fragment@65 {
		target = <0xffffffff>;

		__overlay__ {
			status = "ok";
			qcom,spi-touch-active = "focaltech,fts_ts";

			focaltech@0 {
				status = "okay";
				compatible = "focaltech,fts_ts";
				reg = <0x00>;
				spi-max-frequency = <0x5b8d80>;
				interrupt-parent = <0xffffffff>;
				interrupts = <0x51 0x2008>;
				focaltech,reset-gpio = <0xffffffff 0x69 0x00>;
				focaltech,irq-gpio = <0xffffffff 0x51 0x2008>;
				focaltech,display-coords = <0x00 0x00 0x438 0x960>;
				focaltech,max-touch-number = <0x0a>;
				focaltech,ic-type = <0x3658d488>;
				vdd-supply = <0xffffffff>;
				iovdd-supply = <0xffffffff>;
				pinctrl-names = "pmx_ts_active", "pmx_ts_suspend", "pmx_ts_release";
				pinctrl-0 = <0xffffffff>;
				pinctrl-1 = <0xffffffff 0xffffffff>;
				pinctrl-2 = <0xffffffff>;
				focaltech,trusted-touch-mode = "vm_mode";
				focaltech,touch-environment = "pvm";
				focaltech,trusted-touch-spi-irq = <0x259>;
				focaltech,trusted-touch-io-bases = <0xf134000 0xf135000 0xf136000 0xf137000 0xf169000 0xf151000 0xa94000 0xa10000>;
				focaltech,trusted-touch-io-sizes = <0x1000 0x1000 0x1000 0x1000 0x1000 0x1000 0x1000 0x4000>;
				panel = <0x3e>;
			};

			goodix-berlin@0 {
				status = "disabled";
				compatible = "goodix,gt9916S";
				reg = <0x00>;
				spi-max-frequency = <0xf4240>;
				goodix,avdd-name = "avdd";
				avdd-supply = <0xffffffff>;
				goodix,iovdd-name = "iovdd";
				iovdd-supply = <0xffffffff>;
				goodix,reset-gpio = <0xffffffff 0x69 0x00>;
				goodix,irq-gpio = <0xffffffff 0x51 0x2800>;
				goodix,irq-flags = <0x02>;
				goodix,panel-max-x = <0x438>;
				goodix,panel-max-y = <0x960>;
				goodix,panel-max-w = <0xff>;
				goodix,panel-max-p = <0x1000>;
				goodix,pen-enable;
				goodix,firmware-name = "goodix_firmware.bin";
				goodix,config-name = "goodix_cfg_group.bin";
			};
		};
	};

	fragment@67 {
		target = <0xffffffff>;

		__overlay__ {
			status = "okay";

			goodix_fp@0 {
				compatible = "goodix,fingerprint";
				reg = <0x00>;
				spi-max-frequency = <0x5b8d80>;
				interrupt-parent = <0xffffffff>;
				fp-gpio-power = <0xffffffff 0x02 0x00>;
				fp-gpio-irq = <0xffffffff 0x22 0x00>;
				fp-gpio-reset = <0xffffffff 0x3d 0x00>;
				panel = <0x3e>;
				status = "okay";
			};
		};
	};

	fragment@68 {
		target = <0xffffffff>;

		__overlay__ {
			status = "okay";

			tfa98xx@34 {
				compatible = "tfa,tfa98xx";
				reg = <0x34>;
				reset-gpio = <0xffffffff 0x65 0x00>;
			};

			tfa98xx@35 {
				compatible = "tfa,tfa98xx";
				reg = <0x35>;
			};
		};
	};

	fragment@69 {
		target = <0xffffffff>;

		__overlay__ {

			aw210xx_led_pins {

				led_gpio_en {
					phandle = <0x90>;

					mux {
						pins = "gpio18";
						function = "gpio";
					};

					config {
						pins = "gpio18";
						drive-strength = <0x02>;
						output-high;
						bias-pull-up;
					};
				};
			};
		};
	};

	fragment@70 {
		target = <0xffffffff>;

		__overlay__ {
			status = "ok";

			aw210xx_led@20 {
				compatible = "awinic,aw210xx_led";
				reg = <0x20>;
				enable-gpio = <0xffffffff 0x12 0x00>;
				global_current = <0x20>;
				osc_clk = <0x01>;
				br_res = <0x03>;
				pinctrl-names = "default";
				pinctrl-0 = <0x90>;
				status = "ok";

				aw210xx,led {
					aw210xx,name = "aw210xx_led";
					aw210xx,imax = <0x01>;
					aw210xx,brightness = <0xfff>;
					aw210xx,max_brightness = <0xfff>;
				};
			};
		};
	};

	fragment@72 {
		target = <0xffffffff>;

		__overlay__ {

			hardware_id {
				compatible = "nt,hwid";
				gpio_id1 = <0xffffffff 0x13 0x00>;
				gpio_id2 = <0xffffffff 0x15 0x00>;
			};

			slot_state {
				compatible = "nt,slot_check";
				gpio112 = <0xffffffff 0x70 0x00>;
				gpio116 = <0xffffffff 0x74 0x00>;
			};
		};
	};

	fragment@73 {
		target = <0xffffffff>;

		__overlay__ {
			use-nv-mac;
		};
	};

	fragment@74 {
		target = <0xffffffff>;

		__overlay__ {

			bootloader_log {
				compatible = "nothing,bootloader_log";
				memory-region = <0xffffffff>;
				log,offset_size = <0x4000 0x100000>;
			};
		};
	};

	fragment@75 {
		target = <0xffffffff>;

		__overlay__ {

			ramoops@83a00000 {
				compatible = "ramoops";
				reg = <0x00 0x83a00000 0x00 0x400000>;
				record-size = <0x40000>;
				console-size = <0x1c0000>;
				ftrace-size = <0x00>;
				pmsg-size = <0x200000>;
				mem-type = <0x00>;
				ecc-size = <0x10>;
				dump-oops;
			};
		};
	};

	__fixups__ {
		qupv3_se1_i2c = "/fragment@70:target:0";
		soc = "/fragment@43:target:0", "/fragment@72:target:0", "/fragment@74:target:0";
		mdss_mdp = "/fragment@38:target:0", "/fragment@43/__overlay__/qcom,dsi-display-primary:qcom,mdp:0";
		tlmm = "/fragment@38/__overlay__/qcom,mdss_dsi_rm692e5_visionox_amoled_120hz_cmd:qcom,platform-reset-gpio:0", "/fragment@43/__overlay__/qcom,dsi-display-primary:qcom,platform-te-gpio:0", "/fragment@65/__overlay__/focaltech@0:interrupt-parent:0", "/fragment@65/__overlay__/focaltech@0:focaltech,reset-gpio:0", "/fragment@65/__overlay__/focaltech@0:focaltech,irq-gpio:0", "/fragment@65/__overlay__/goodix-berlin@0:goodix,reset-gpio:0", "/fragment@65/__overlay__/goodix-berlin@0:goodix,irq-gpio:0", "/fragment@67/__overlay__/goodix_fp@0:interrupt-parent:0", "/fragment@67/__overlay__/goodix_fp@0:fp-gpio-power:0", "/fragment@67/__overlay__/goodix_fp@0:fp-gpio-irq:0", "/fragment@67/__overlay__/goodix_fp@0:fp-gpio-reset:0", "/fragment@68/__overlay__/tfa98xx@34:reset-gpio:0", "/fragment@69:target:0", "/fragment@70/__overlay__/aw210xx_led@20:enable-gpio:0", "/fragment@72/__overlay__/hardware_id:gpio_id1:0", "/fragment@72/__overlay__/hardware_id:gpio_id2:0", "/fragment@72/__overlay__/slot_state:gpio112:0", "/fragment@72/__overlay__/slot_state:gpio116:0";
		mdss_dsi0 = "/fragment@43/__overlay__/qcom,dsi-display-primary:qcom,dsi-ctrl:0";
		mdss_dsi_phy0 = "/fragment@43/__overlay__/qcom,dsi-display-primary:qcom,dsi-phy:0", "/fragment@43/__overlay__/qcom,dsi-display-primary:clocks:0", "/fragment@43/__overlay__/qcom,dsi-display-primary:clocks:8", "/fragment@43/__overlay__/qcom,dsi-display-primary:clocks:16", "/fragment@43/__overlay__/qcom,dsi-display-primary:clocks:24", "/fragment@43/__overlay__/qcom,dsi-display-primary:clocks:32", "/fragment@43/__overlay__/qcom,dsi-display-primary:clocks:40", "/fragment@43/__overlay__/qcom,dsi-display-primary:clocks:48", "/fragment@43/__overlay__/qcom,dsi-display-primary:clocks:56", "/fragment@43/__overlay__/qcom,dsi-display-primary:clocks:64", "/fragment@43/__overlay__/qcom,dsi-display-primary:clocks:72";
		dispcc = "/fragment@43/__overlay__/qcom,dsi-display-primary:clocks:80";
		L12C = "/fragment@43/__overlay__/qcom,dsi-display-primary:vddio-supply:0";
		L13C = "/fragment@43/__overlay__/qcom,dsi-display-primary:vdd-supply:0";
		qupv3_se13_i2c = "/fragment@64:target:0";
		qupv3_se13_spi = "/fragment@65:target:0";
		L3C = "/fragment@65/__overlay__/focaltech@0:vdd-supply:0", "/fragment@65/__overlay__/goodix-berlin@0:avdd-supply:0";
		L8C = "/fragment@65/__overlay__/focaltech@0:iovdd-supply:0", "/fragment@65/__overlay__/goodix-berlin@0:iovdd-supply:0";
		ts_active = "/fragment@65/__overlay__/focaltech@0:pinctrl-0:0";
		ts_int_suspend = "/fragment@65/__overlay__/focaltech@0:pinctrl-1:0";
		ts_reset_suspend = "/fragment@65/__overlay__/focaltech@0:pinctrl-1:4";
		ts_release = "/fragment@65/__overlay__/focaltech@0:pinctrl-2:0";
		qupv3_se14_spi = "/fragment@67:target:0";
		qupv3_se2_i2c = "/fragment@68:target:0";
		icnss2 = "/fragment@73:target:0";
		reserved_xbl_uefi = "/fragment@74/__overlay__/bootloader_log:memory-region:0";
		reserved_memory = "/fragment@75:target:0";
	};

	__local_fixups__ {

		fragment@38 {

			__overlay__ {

				qcom,mdss_dsi_rm692e5_visionox_amoled_120hz_cmd {
					qcom,panel-supply-entries = <0x00>;
				};
			};
		};

		fragment@43 {

			__overlay__ {

				qcom,dsi-display-primary {
					qcom,dsi-default-panel = <0x00>;
				};
			};
		};

		fragment@65 {

			__overlay__ {

				focaltech@0 {
					panel = <0x00>;
				};
			};
		};

		fragment@67 {

			__overlay__ {

				goodix_fp@0 {
					panel = <0x00>;
				};
			};
		};

		fragment@70 {

			__overlay__ {

				aw210xx_led@20 {
					pinctrl-0 = <0x00>;
				};
			};
		};
	};
};
